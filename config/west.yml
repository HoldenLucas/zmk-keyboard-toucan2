## config/west.yml
```yaml
manifest:
  remotes:
    - name: zmkfirmware
      url-base: https://github.com/zmkfirmware
    - name: urob
      url-base: https://github.com/urob
    - name: caksoylar
      url-base: https://github.com/caksoylar
    - name: geeksville
      url-base: https://github.com/geeksville
    - name: beekeeb
      url-base: https://github.com/beekeeb
  projects:
    - name: zmk
      remote: zmkfirmware
      import: app/west.yml
      revision: v0.3
    - name: zmk-helpers
      remote: urob
      revision: 95edb8f15ef1d1bd8332810555f8cf5837fbdd27 # main (urob pin)
    - name: zmk-rgbled-widget
      remote: caksoylar
      revision: v0.3
    - name: zmk_driver_azoteq
      remote: beekeeb
      revision: main
    - name: zmk-input-zoom
      remote: beekeeb
      revision: main
  self:
    path: config
```
